## systems/rock-star-os/os/buildroot/Config.in
```kconfig
source "$BR2_EXTERNAL_ROCK_PATH/package/rock-core/Config.in"
source "$BR2_EXTERNAL_ROCK_PATH/package/rock-platform/Config.in"
source "$BR2_EXTERNAL_ROCK_PATH/package/rock-ui/Config.in"
```

## systems/rock-star-os/os/buildroot/configs/rock_virt_aarch64_defconfig
```kconfig
# Development virtual board. NOT a BlackBerry flash image.
BR2_aarch64=y
BR2_PACKAGE_BUSYBOX_SHOW_OTHERS=y
BR2_JLEVEL=4
BR2_PRIMARY_SITE="https://sources.buildroot.net"
BR2_TOOLCHAIN_BUILDROOT_MUSL=y
BR2_PACKAGE_HOST_LINUX_HEADERS_CUSTOM_6_18=y
BR2_GLOBAL_PATCH_DIR="$(BR2_EXTERNAL_ROCK_PATH)/patches board/qemu/patches"
BR2_DOWNLOAD_FORCE_CHECK_HASHES=y
BR2_TARGET_GENERIC_HOSTNAME="rock-star-os"
BR2_TARGET_GENERIC_ISSUE="RockstarOS 1.0 Developer Preview - ARM64 QEMU development OS"
BR2_SYSTEM_BIN_SH_DASH=y
# BR2_TARGET_ENABLE_ROOT_LOGIN is not set
# BR2_TARGET_GENERIC_REMOUNT_ROOTFS_RW is not set
BR2_TARGET_GENERIC_GETTY_PORT="ttyAMA0"
BR2_ROOTFS_USERS_TABLES="$(BR2_EXTERNAL_ROCK_PATH)/board/rock-virt/users.txt"
BR2_ROOTFS_OVERLAY="$(BR2_EXTERNAL_ROCK_PATH)/board/rock-virt/overlay"
BR2_ROOTFS_POST_BUILD_SCRIPT="$(BR2_EXTERNAL_ROCK_PATH)/board/rock-virt/post-build.sh"
BR2_LINUX_KERNEL=y
BR2_LINUX_KERNEL_CUSTOM_VERSION=y
BR2_LINUX_KERNEL_CUSTOM_VERSION_VALUE="6.18.50"
BR2_LINUX_KERNEL_USE_CUSTOM_CONFIG=y
BR2_LINUX_KERNEL_CUSTOM_CONFIG_FILE="board/qemu/aarch64-virt/linux.config"
BR2_LINUX_KERNEL_CONFIG_FRAGMENT_FILES="$(BR2_EXTERNAL_ROCK_PATH)/board/rock-virt/linux.fragment"
BR2_LINUX_KERNEL_NEEDS_HOST_OPENSSL=y
BR2_PACKAGE_BUSYBOX_CONFIG_FRAGMENT_FILES="$(BR2_EXTERNAL_ROCK_PATH)/board/rock-virt/busybox.fragment"
BR2_PACKAGE_ROCK_CORE=y
BR2_PACKAGE_ROCK_PLATFORM=y
BR2_PACKAGE_ROCK_UI=y
BR2_PACKAGE_PYTHON3_PY_PYC=y
BR2_PACKAGE_PYTHON3_ZLIB=y
BR2_PACKAGE_CAIRO=y
BR2_PACKAGE_CAIRO_PNG=y
BR2_PACKAGE_FREETYPE=y
BR2_PACKAGE_JSON_C=y
BR2_TARGET_ROOTFS_EXT2=y
BR2_TARGET_ROOTFS_EXT2_4=y
BR2_TARGET_ROOTFS_EXT2_SIZE="384M"
# BR2_TARGET_ROOTFS_TAR is not set
```

## systems/rock-star-os/os/buildroot/package/rock-core/Config.in
```kconfig
config BR2_PACKAGE_ROCK_CORE
	bool "rock-core"
	help
	  Rock star os boot service and local IPC client.
	  This development component is not a general untrusted-code runtime.
```

## systems/rock-star-os/os/buildroot/package/rock-platform/Config.in
```kconfig
config BR2_PACKAGE_ROCK_PLATFORM
	bool "Rock star os platform service and isolated recipe runtime"
	depends on BR2_USE_WCHAR
	depends on BR2_TOOLCHAIN_HAS_THREADS
	depends on !BR2_STATIC_LIBS
	select BR2_PACKAGE_PYTHON3
	select BR2_PACKAGE_PYTHON3_SQLITE
	select BR2_PACKAGE_PYTHON3_SSL
	select BR2_PACKAGE_LIBOPENSSL_BIN
	select BR2_PACKAGE_BUBBLEWRAP
	select BR2_PACKAGE_LIBSECCOMP
```

## systems/rock-star-os/os/buildroot/package/rock-ui/Config.in
```kconfig
config BR2_PACKAGE_ROCK_UI
	bool "rock-ui"
	depends on BR2_TOOLCHAIN_HAS_THREADS
	depends on BR2_TOOLCHAIN_HAS_SYNC_4
	select BR2_PACKAGE_CAIRO
	select BR2_PACKAGE_CAIRO_PNG
	select BR2_PACKAGE_FREETYPE
	select BR2_PACKAGE_JSON_C
	help
	  Native Rock star os framebuffer Hub with evdev input and local
	  authenticated Unix-domain platform API. No browser or X server.
	  A Japanese OpenType font must be installed separately at
	  /usr/share/fonts/rock/NotoSansCJKjp-Regular.otf.

comment "rock-ui needs a toolchain with threads and 32-bit atomic operations"
	depends on !BR2_TOOLCHAIN_HAS_THREADS || !BR2_TOOLCHAIN_HAS_SYNC_4
```
